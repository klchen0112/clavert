## config/boards/shields/clavert/Kconfig.defconfig
```kconfig
# Copyright (c) 2021 The ZMK Contributors
# SPDX-License-Identifier: MIT

if SHIELD_CLAVERT_ENGRAMMER_LEFT

config ZMK_KEYBOARD_NAME
	default "ClavertEngrammer"

config ZMK_SPLIT_ROLE_CENTRAL
	default y

endif

if SHIELD_CLAVERT_ENGRAMMER_LEFT || SHIELD_CLAVERT_ENGRAMMER_RIGHT

config ZMK_SPLIT
	default y

endif
```

## config/boards/shields/clavert/Kconfig.shield
```kconfig
# Copyright (c) 2021 The ZMK Contributors
# SPDX-License-Identifier: MIT
config SHIELD_CLAVERT_ENGRAMMER_LEFT
	def_bool $(shields_list_contains,clavert_engrammer_left)

config SHIELD_CLAVERT_ENGRAMMER_RIGHT
	def_bool $(shields_list_contains,clavert_engrammer_right)
```

## config/boards/shields/clavert_qwerty/Kconfig.defconfig
```kconfig
# Copyright (c) 2021 The ZMK Contributors
# SPDX-License-Identifier: MIT

if SHIELD_CLAVERT_QWERTY_LEFT

config ZMK_KEYBOARD_NAME
	default "ClavertQWERTY"

config ZMK_SPLIT_ROLE_CENTRAL
	default y

endif

if SHIELD_CLAVERT_QWERTY_LEFT || SHIELD_CLAVERT_QWERTY_RIGHT

config ZMK_SPLIT
	default y

endif
```
