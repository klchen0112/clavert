
/*
* Copyright (c) 2020 The ZMK Contributors
*
* SPDX-License-Identifier: MIT
*/

#include <behaviors.dtsi>
#include <behaviors/num_word.dtsi> // requires auto-layer module
#include <dt-bindings/zmk/keys.h>

#include <dt-bindings/zmk/bt.h>
#include <dt-bindings/zmk/outputs.h>

#include "zmk-helpers/helper.h"

/* Combos, leader key sequences, mouse emulation */



#include "clavert_keys.h"

#define DEF 0
#define NUM 1
#define FN 2
#define NAV 3
#define SYM 4
#define MOS 5
#define SYS 6


#define XXX &none
#define ___ &trans

/* Global settings */

#define QUICK_TAP_MS 175

&sk {  // sticky-key config
    release-after-ms = <900>;  // release after 0.6s
    quick-release;             // no double capitalization when rolling keys
};

&sl {  // sticky-layer config
    ignore-modifiers;          // allow chording sticky mods & layers
};

&lt {  // layer-tap config
    flavor = "balanced";
    tapping-term-ms = <200>;
    quick-tap-ms = <QUICK_TAP_MS>;
};

/* Homerow mods */

#define KEYS_L LT0 LT1 LT2 LT3 LT4 LM0 LM1 LM2 LM3 LM4 LB0 LB1 LB2 LB3 LB4  // left hand
#define KEYS_R RT0 RT1 RT2 RT3 RT4 RM0 RM1 RM2 RM3 RM4 RB0 RB1 RB2 RB3 RB4  // right hand
#define THUMBS LH2 LH1 LH0 RH0 RH1 RH2                                      // thumbs

#define MAKE_HRM(NAME, HOLD, TAP, TRIGGER_POS) \
    ZMK_BEHAVIOR(NAME, hold_tap, \
        flavor = "balanced"; \
        tapping-term-ms = <280>; \
        quick-tap-ms = <QUICK_TAP_MS>; \
        require-prior-idle-ms = <150>; \
        bindings = <HOLD>, <TAP>; \
        hold-trigger-key-positions = <TRIGGER_POS>; \
        hold-trigger-on-release; \
    )
MAKE_HRM(hml, &kp, &kp, KEYS_R THUMBS)  // left-hand HRMs
MAKE_HRM(hmr, &kp, &kp, KEYS_L THUMBS)  // right-hand HRMs

MAKE_HRM(hml_repeat, &kp, &key_repeat, KEYS_R THUMBS)  // used for HRM-combo

// Hack: Make HRM combos tap-only (cf, ZMK issue #544).
#define ZMK_COMBO_8(NAME, TAP, POS, LAYERS, COMBO_MS, IDLE_MS, HOLD, SIDE)     \
  MAKE_HRM(hm_combo_##NAME, &kp, TAP, SIDE THUMBS)                             \
  ZMK_COMBO_6(NAME, &hm_combo_##NAME HOLD 0, POS, LAYERS, COMBO_MS, IDLE_MS)


//#include "combos.dtsi" // Must be sourced after HRM-combo hack.
//#include "leader.dtsi"
#include "mouse.dtsi"

/* Nav cluster */

// long-tap action on hold, short-tap action on all interrupts
#define MT_CORE \
    flavor = "tap-preferred"; \
    tapping-term-ms = <220>; \
    quick-tap-ms = <220>; \
    hold-trigger-key-positions = <0>;

&mt { MT_CORE };
&mt { MT_CORE };
ZMK_HOLD_TAP(mt_home, bindings = <&masked_home>, <&kp>; MT_CORE)
ZMK_HOLD_TAP(mt_end, bindings = <&masked_end>, <&kp>; MT_CORE)

#define NAV_LEFT  &mt_home 0   LEFT    // tap: left  | long-tap: beginning of line
#define NAV_RIGHT &mt_end 0    RIGHT   // tap: right | long-tap: end       of line
#define NAV_UP    &mt LC(HOME) UP      // tap: up    | long-tap: beginning of document
#define NAV_DOWN  &mt LC(END)  DOWN    // tap: down  | long-tap: end       of document
#define NAV_BSPC  &mt LC(BSPC) BSPC    // tap: bspc  | long-tap: delete word backward
#define NAV_DEL   &mt LC(DEL)  DEL     // tap: del   | long-tap: delete word forward

// mask CTRL when holding left/right to avoid accidental jumps to beginning/end of document
#define MASK_MODS(NAME, MODS, BINDING) \
    ZMK_BEHAVIOR(NAME, mod_morph, \
        bindings = <BINDING>, <BINDING>; \
        mods = <MODS>; \
    )
MASK_MODS(masked_home, (MOD_LCTL), &kp HOME)
MASK_MODS(masked_end,  (MOD_LCTL), &kp END)

/* Caps-word, num-word and smart-MOS */

// Tap: repeat after alpha, else sticky-shift |
// Shift + tap/ double-tap: caps-word | Hold: shift.
#define MAGIC_SHIFT &magic_shift LSHFT 0
ZMK_HOLD_TAP(magic_shift, bindings = <&kp>, <&magic_shift_tap>;
             flavor = "balanced"; tapping-term-ms = <200>;
             quick-tap-ms = <QUICK_TAP_MS>;)
ZMK_MOD_MORPH(magic_shift_tap, bindings = <&shift_repeat>, <&caps_word>;
              mods = <(MOD_LSFT)>;)
ZMK_ADAPTIVE_KEY(
    shift_repeat, bindings = <&sk LSHFT>;
    repeat {
      trigger-keys = <A B C D E F G H I J K L M N O P Q R S T U V W X Y Z>;
      bindings = <&key_repeat>;
      max-prior-idle-ms = <1200>;
      strict-modifiers;
    };)
&caps_word { // Mods deactivate caps-word, requires PR #1451. [TODO: rebase]
  /delete-property/ ignore-modifiers;
};


// Tap: num-word | double-tap: sticky num-layer | Hold: num-layer.
#define SMART_NUM &smart_num NUM 0
ZMK_HOLD_TAP(smart_num, bindings = <&mo>, <&num_dance>; flavor = "balanced";
             tapping-term-ms = <200>; quick-tap-ms = <QUICK_TAP_MS>;)
ZMK_TAP_DANCE(num_dance, bindings = <&num_word NUM>, <&sl NUM>;
              tapping-term-ms = <200>;)

// Smart-mouse, requires tri-state module.
ZMK_TRI_STATE(
    smart_mouse, bindings = <&tog MOS>, <&none>, <&tog MOS>;
    ignored-key-positions =
        <LT1 LT2 LH0 LH1 RT1 RT2 RT3 RM0 RM1 RM2 RM3 RM4 RB1 RB2 RB3 RH0 RH1>;
    ignored-layers = <MOS NAV FN>;)

/* Custom behaviors */

// Alt+Tab swapper, requires tri-state module.
ZMK_TRI_STATE(swapper, bindings = <&kt LALT>, <&kp TAB>, <&kt LALT>;
              ignored-key-positions = <LT2 RT2 RM1 RM2 RM3>;)


/* Custom behaviors */

// Alt+Tab swapper, requires PR #1366
ZMK_TRI_STATE(swapper,
    bindings = <&kt LALT>, <&kp TAB>, <&kt LALT>;
    ignored-key-positions = <LT2>;
)

// Define mod-morph with a *single* mod trigger for less repetition.
#define SIMPLE_MORPH(NAME, MOD, BINDING1, BINDING2)                            \
  ZMK_MOD_MORPH(NAME, mods = <(MOD_L##MOD | MOD_R##MOD)>;                      \
                bindings = <BINDING1>, <BINDING2>;)

// Tap: space | Shift + tap: dot -> space -> sticky shift | Hold: nav layer.
ZMK_HOLD_TAP(lt_spc, bindings = <&mo>, <&spc_morph>; flavor = "balanced";
             tapping-term-ms = <200>; quick-tap-ms = <QUICK_TAP_MS>;)
SIMPLE_MORPH(spc_morph, SFT, &kp SPACE, &dot_spc)
ZMK_MACRO(dot_spc, bindings = <&kp DOT &kp SPACE &sk LSHFT>; wait-ms = <0>;
          tap-ms = <5>;)

// Tap: backspace | Lshft + tap: delete | Rshft + tap: shift-delete.
ZMK_MOD_MORPH(bs_del, bindings = <&kp BSPC>, <&kp DEL>;
              mods = <(MOD_LSFT|MOD_RSFT)>; keep-mods = <MOD_RSFT>;)

// Tap: copy | double-tap: cut.
ZMK_TAP_DANCE(copy_cut, bindings = <&kp LC(INS)>, <&kp LC(X)>;
              tapping-term-ms = <200>;)


ZMK_TAP_DANCE(bt_0,
    tapping-term-ms = <200>;
    bindings = <&bt BT_SEL 0>, <&bt BT_DISC 0>;  // reverse this for sticky-num on single tap
)

ZMK_TAP_DANCE(bt_1,
    tapping-term-ms = <200>;
    bindings = <&bt BT_SEL 1>, <&bt BT_DISC 1>;  // reverse this for sticky-num on single tap
)

ZMK_TAP_DANCE(bt_2,
    tapping-term-ms = <200>;
    bindings = <&bt BT_SEL 2>, <&bt BT_DISC 2>;  // reverse this for sticky-num on single tap
)

ZMK_TAP_DANCE(bt_3,
    tapping-term-ms = <200>;
    bindings = <&bt BT_SEL 3>, <&bt BT_DISC 3>;  // reverse this for sticky-num on single tap
)
// Misc aliases. [TODO: clean up]
#define CANCEL      &kp K_CANCEL             // cancel caps-word, num-word and smart-MOS
#define DSK_PREV    &hmr LALT LG(LC(LEFT))   // previous desktop
#define DSK_NEXT    &hmr LCTRL LG(LC(RIGHT)) // next     desktop
#define DSK_MGR     &kp LA(GRAVE)            // desktop manager
#define VOL_DOWN    &hmr RSHFT C_VOL_DN

/* Keymap */

ZMK_LAYER_3(DEF,
//╭─────────────┬─────────────┬─────────────┬─────────────┬─────────────┬─────────────┬─────────────┬─────────────╮  ╭─────────────┬─────────────┬─────────────┬─────────────┬─────────────┬─────────────┬─────────────┬─────────────╮
    &lt SYS GRAVE &kp N1        &kp N2        &kp N3        &kp N4        &kp N5                                                                   &kp N6        &kp N7        &kp N8        &kp N9        &kp N0        &lt SYS RSHFT
//├─────────────┼─────────────┼─────────────┼─────────────┼─────────────┼─────────────┼─────────────┼─────────────┤  ├─────────────┼─────────────┼─────────────┼─────────────┼─────────────┼─────────────┼─────────────┼─────────────┤
    &kp LBKT      &kp B         &kp Y         &kp O         &kp U         &kp SQT       &key_repeat                                  &key_repeat   &kp SEMI      &kp L         &kp D         &kp W         &kp V         &kp RBKT
//├─────────────┼─────────────┼─────────────┼─────────────┼─────────────┼─────────────┼─────────────┼─────────────┤  ├─────────────┼─────────────┼─────────────┼─────────────┼─────────────┼─────────────┼─────────────┼─────────────┤
    &kp COMMA     &hml LGUI C   &hml LALT I   &hml LCTRL E  &hml LSHFT A  &kp Z         &kp FSLH                                     &kp BSLH      &kp Q         &hmr RSHFT H  &hmr RCTRL T  &hmr RALT S   &hmr RGUI N   &kp DOT
//├─────────────┼─────────────┼─────────────┼─────────────┼─────────────┼─────────────┼─────────────┼─────────────┤  ├─────────────┼─────────────┼─────────────┼─────────────┼─────────────┼─────────────┼─────────────┼─────────────┤
    &kp FSLH      &kp G         &kp X         &kp J         &kp K         &kp MINUS     &copy_cut     &lt FN END      &swapper       SMART_NUM    &kp EQUAL     &kp R         &kp M         &kp F         &kp P         &kp BSLH
//├─────────────┼─────────────┼─────────────┼─────────────┼─────────────┼─────────────┼─────────────┼─────────────┤  ├─────────────┼─────────────┼─────────────┼─────────────┼─────────────┼─────────────┼─────────────┼─────────────┤
    NAV_LEFT      NAV_RIGHT     &kp LGUI      &kp LCTRL                   &lt NAV TAB   MAGIC_SHIFT   &kp ESC         &lt SYM ENTER  &lt_spc MOS 0 NAV_BSPC                    &kp RCTRL     &kp RGUI      NAV_UP        NAV_DOWN
//╰─────────────┴─────────────┴─────────────┴─────────────┴─────────────┴─────────────┴─────────────┴─────────────╯  ╰─────────────┴─────────────┴─────────────┴─────────────┴─────────────┴─────────────┴─────────────┴─────────────╯
,&inc_dec_kp LEFT RIGHT
)



ZMK_LAYER_3(NUM,
//╭─────────────┬─────────────┬─────────────┬─────────────┬─────────────┬─────────────┬─────────────┬─────────────╮  ╭─────────────┬─────────────┬─────────────┬─────────────┬─────────────┬─────────────┬─────────────┬─────────────╮
    XXX           XXX           XXX           XXX           XXX           XXX                                                                      &kp CARET     &kp HASH      &kp DLLR      &kp TILDE     &kp MINUS     &kp PIPE
//├─────────────┼─────────────┼─────────────┼─────────────┼─────────────┼─────────────┼─────────────┼─────────────┤  ├─────────────┼─────────────┼─────────────┼─────────────┼─────────────┼─────────────┼─────────────┼─────────────┤
    XXX           XXX           XXX           XXX           XXX           XXX           XXX                                          ___           &kp PRCNT     &kp N7        &kp N8        &kp N9        &kp COLON     &kp K
//├─────────────┼─────────────┼─────────────┼─────────────┼─────────────┼─────────────┼─────────────┼─────────────┤  ├─────────────┼─────────────┼─────────────┼─────────────┼─────────────┼─────────────┼─────────────┼─────────────┤
    &kp KP_NUM    &kp LGUI      &kp LALT      &kp LCTRL     &kp LSHFT     &kp TAB       XXX                                          XXX           &kp PLUS      &kp N4        &kp N5        &kp N6        &kp MINUS     &kp J
//├─────────────┼─────────────┼─────────────┼─────────────┼─────────────┼─────────────┼─────────────┼─────────────┤  ├─────────────┼─────────────┼─────────────┼─────────────┼─────────────┼─────────────┼─────────────┼─────────────┤
    XXX           &sk LSHFT     &kp K_UNDO    &kp BSPC      &kp SPACE     &kp RET       ___           ___              ___           XXX           &kp STAR      &kp N1        &kp N2        &kp N3        &kp FSLH      &kp LS(G)
//├─────────────┼─────────────┼─────────────┼─────────────┼─────────────┼─────────────┼─────────────┼─────────────┤  ├─────────────┼─────────────┼─────────────┼─────────────┼─────────────┼─────────────┼─────────────┼─────────────┤
    ___           XXX           &kp K_REDO    &kp DEL                     &tog NUM      ___           ___              ___           ___           ___                         &kp N0        &kp DOT       &kp ENTER     &kp AT
//╰─────────────┴─────────────┴─────────────┴─────────────┴─────────────┴─────────────┴─────────────┴─────────────╯  ╰─────────────┴─────────────┴─────────────┴─────────────┴─────────────┴─────────────┴─────────────┴─────────────╯
,&inc_dec_kp PG_UP PG_DN)


ZMK_LAYER_3(FN,
//╭─────────────┬─────────────┬─────────────┬─────────────┬─────────────┬─────────────┬─────────────┬─────────────╮  ╭─────────────┬─────────────┬─────────────┬─────────────┬─────────────┬─────────────┬─────────────┬─────────────╮
    XXX           XXX           XXX           XXX           XXX           XXX                                                                      XXX           XXX           XXX           XXX           XXX           XXX
//├─────────────┼─────────────┼─────────────┼─────────────┼─────────────┼─────────────┼─────────────┼─────────────┤  ├─────────────┼─────────────┼─────────────┼─────────────┼─────────────┼─────────────┼─────────────┼─────────────┤
    XXX           XXX           XXX           XXX           XXX           XXX           XXX                                          XXX           XXX           &kp F7        &kp F8        &kp F9        &kp F10       &kp F13
//├─────────────┼─────────────┼─────────────┼─────────────┼─────────────┼─────────────┼─────────────┼─────────────┤  ├─────────────┼─────────────┼─────────────┼─────────────┼─────────────┼─────────────┼─────────────┼─────────────┤
    ___           XXX           XXX           XXX           XXX           ___           XXX                                          XXX           XXX           &kp F4        &kp F5        &kp F6        &kp F11       &kp F14
//├─────────────┼─────────────┼─────────────┼─────────────┼─────────────┼─────────────┼─────────────┼─────────────┤  ├─────────────┼─────────────┼─────────────┼─────────────┼─────────────┼─────────────┼─────────────┼─────────────┤
    ___           XXX           XXX           XXX           XXX           ___           ___           ___              ___           ___           XXX           &kp F1        &kp F2        &kp F3        &kp F12       &kp F15
//├─────────────┼─────────────┼─────────────┼─────────────┼─────────────┼─────────────┼─────────────┼─────────────┤  ├─────────────┼─────────────┼─────────────┼─────────────┼─────────────┼─────────────┼─────────────┼─────────────┤
    ___           XXX           ___           ___                         &tog FN       ___           ___              ___           ___           &tog FN                     &kp C_RW      &kp C_FF      XXX           XXX
//╰─────────────┴─────────────┴─────────────┴─────────────┴─────────────┴─────────────┴─────────────┴─────────────╯  ╰─────────────┴─────────────┴─────────────┴─────────────┴─────────────┴─────────────┴─────────────┴─────────────╯
,&inc_dec_kp LEFT RIGHT)


ZMK_LAYER_3(NAV,
//╭─────────────┬─────────────┬─────────────┬─────────────┬─────────────┬─────────────┬─────────────┬─────────────╮  ╭─────────────┬─────────────┬─────────────┬─────────────┬─────────────┬─────────────┬─────────────┬─────────────╮
    XXX           XXX           XXX           XXX           &kp DEL       &kp INS                                                                  &kp INS       &kp DEL       XXX           XXX           XXX           XXX
//├─────────────┼─────────────┼─────────────┼─────────────┼─────────────┼─────────────┼─────────────┼─────────────┤  ├─────────────┼─────────────┼─────────────┼─────────────┼─────────────┼─────────────┼─────────────┼─────────────┤
    XXX           &sk LSHFT     &kp K_REDO    &kp K_UNDO    &kp BSPC      &kp K_CUT     XXX                                          XXX           &kp K_CUT     &kp K_UNDO    &kp UP        &kp K_REDO    &sk RSHFT     XXX
//├─────────────┼─────────────┼─────────────┼─────────────┼─────────────┼─────────────┼─────────────┼─────────────┤  ├─────────────┼─────────────┼─────────────┼─────────────┼─────────────┼─────────────┼─────────────┼─────────────┤
    XXX           &kp LGUI      &kp LALT      &kp LCTRL     &kp LSHFT     &kp K_COPY    XXX                                          XXX           &kp K_COPY    &kp LEFT      &kp DOWN      &kp RIGHT     &kp BSPC      XXX
//├─────────────┼─────────────┼─────────────┼─────────────┼─────────────┼─────────────┼─────────────┼─────────────┤  ├─────────────┼─────────────┼─────────────┼─────────────┼─────────────┼─────────────┼─────────────┼─────────────┤
    XXX           XXX           XXX           XXX           XXX           &kp K_PASTE   &kp TAB       XXX              XXX           XXX           &kp K_PASTE   &kp HOME      &kp PG_UP     &kp PG_DN     &kp END       XXX
//├─────────────┼─────────────┼─────────────┼─────────────┼─────────────┼─────────────┼─────────────┼─────────────┤  ├─────────────┼─────────────┼─────────────┼─────────────┼─────────────┼─────────────┼─────────────┼─────────────┤
    XXX           XXX           XXX           XXX                         &tog NAV      XXX           XXX              XXX           XXX           &tog NAV                    &kp K_FIND    XXX           XXX           XXX
//╰─────────────┴─────────────┴─────────────┴─────────────┴─────────────┴─────────────┴─────────────┴─────────────╯  ╰─────────────┴─────────────┴─────────────┴─────────────┴─────────────┴─────────────┴─────────────┴─────────────╯
,&inc_dec_kp LEFT RIGHT)


ZMK_LAYER_3(SYM,
//╭─────────────┬─────────────┬─────────────┬─────────────┬─────────────┬─────────────┬─────────────┬─────────────╮  ╭─────────────┬─────────────┬─────────────┬─────────────┬─────────────┬─────────────┬─────────────┬─────────────╮
    XXX           &kp GRAVE     &kp LPAR      &kp RPAR      &kp SEMI      &kp COMMA                                                                XXX           XXX           XXX           XXX           XXX           XXX
//├─────────────┼─────────────┼─────────────┼─────────────┼─────────────┼─────────────┼─────────────┼─────────────┤  ├─────────────┼─────────────┼─────────────┼─────────────┼─────────────┼─────────────┼─────────────┼─────────────┤
    &kp EXCL      &kp LBRC      &kp SQT       &kp DQT       &kp RBRC      &kp QMARK     &kp COLON                                    XXX           ___           &kp RSHFT     &kp RCTRL     &kp RALT      &kp RGUI      XXX
//├─────────────┼─────────────┼─────────────┼─────────────┼─────────────┼─────────────┼─────────────┼─────────────┤  ├─────────────┼─────────────┼─────────────┼─────────────┼─────────────┼─────────────┼─────────────┼─────────────┤
    &kp HASH      &kp CARET     &kp EQUAL     &kp UNDER     &kp DLLR      &kp STAR      &kp SEMI                                     XXX           ___           &kp BSPC      &kp TAB       &kp SPACE     &kp RET       XXX
//├─────────────┼─────────────┼─────────────┼─────────────┼─────────────┼─────────────┼─────────────┼─────────────┤  ├─────────────┼─────────────┼─────────────┼─────────────┼─────────────┼─────────────┼─────────────┼─────────────┤
    &kp TILDE     &kp LT        &kp PIPE      &kp MINUS     &kp GT        &kp FSLH      &kp BSLH      &kp DOT          XXX           XXX           ___           &kp DEL       &kp LS(TAB)    XXX          XXX           XXX
//├─────────────┼─────────────┼─────────────┼─────────────┼─────────────┼─────────────┼─────────────┼─────────────┤  ├─────────────┼─────────────┼─────────────┼─────────────┼─────────────┼─────────────┼─────────────┼─────────────┤
    &kp AT        &kp AMPS      &kp LBKT      &kp RBKT                    &kp PLUS      &kp PRCNT     &kp STAR         XXX           XXX           &tog SYM                    ___           XXX           XXX           XXX
//╰─────────────┴─────────────┴─────────────┴─────────────┴─────────────┴─────────────┴─────────────┴─────────────╯  ╰─────────────┴─────────────┴─────────────┴─────────────┴─────────────┴─────────────┴─────────────┴─────────────╯
,&inc_dec_kp LEFT RIGHT)

ZMK_LAYER_3(MOU,
//╭─────────────┬─────────────┬─────────────┬─────────────┬─────────────┬─────────────┬─────────────┬─────────────╮  ╭─────────────┬─────────────┬─────────────┬─────────────┬─────────────┬─────────────┬─────────────┬─────────────╮
    XXX           XXX           XXX           XXX           XXX           XXX                                                                      XXX           XXX           XXX           XXX           XXX           XXX
//├─────────────┼─────────────┼─────────────┼─────────────┼─────────────┼─────────────┼─────────────┼─────────────┤  ├─────────────┼─────────────┼─────────────┼─────────────┼─────────────┼─────────────┼─────────────┼─────────────┤
    XXX           U_WH_L        U_WH_D        U_MS_U        U_WH_U        U_WH_R        XXX                                          ___           XXX           &kp RSHFT     &kp RCTRL     &kp RALT      &kp RGUI      XXX
//├─────────────┼─────────────┼─────────────┼─────────────┼─────────────┼─────────────┼─────────────┼─────────────┤  ├─────────────┼─────────────┼─────────────┼─────────────┼─────────────┼─────────────┼─────────────┼─────────────┤
    XXX           XXX           U_MS_L        U_MS_D        U_MS_R        XXX           XXX                                          ___           XXX           &kp BSPC      &kp TAB       &kp SPACE     &kp RET       XXX
//├─────────────┼─────────────┼─────────────┼─────────────┼─────────────┼─────────────┼─────────────┼─────────────┤  ├─────────────┼─────────────┼─────────────┼─────────────┼─────────────┼─────────────┼─────────────┼─────────────┤
    XXX           XXX           &mkp LCLK     &mkp MCLK     &mkp RCLK     XXX           XXX           XXX              XXX           ___           XXX           &kp DEL       &kp LS(TAB)   XXX           XXX           XXX
//├─────────────┼─────────────┼─────────────┼─────────────┼─────────────┼─────────────┼─────────────┼─────────────┤  ├─────────────┼─────────────┼─────────────┼─────────────┼─────────────┼─────────────┼─────────────┼─────────────┤
    XXX           XXX           XXX           XXX                         XXX           XXX           XXX              XXX           XXX           &tog MOS                    ___           XXX           XXX           XXX
//╰─────────────┴─────────────┴─────────────┴─────────────┴─────────────┴─────────────┴─────────────┴─────────────╯  ╰─────────────┴─────────────┴─────────────┴─────────────┴─────────────┴─────────────┴─────────────┴─────────────╯
,&inc_dec_kp LEFT RIGHT)



ZMK_LAYER_3(SYS,
//╭─────────────┬─────────────┬─────────────┬─────────────┬─────────────┬─────────────┬─────────────┬─────────────╮  ╭─────────────┬─────────────┬─────────────┬─────────────┬─────────────┬─────────────┬─────────────┬─────────────╮
    XXX           &soft_off     XXX           XXX           XXX           XXX                                                                      XXX           XXX           XXX           XXX           &soft_off     XXX
//├─────────────┼─────────────┼─────────────┼─────────────┼─────────────┼─────────────┼─────────────┼─────────────┤  ├─────────────┼─────────────┼───────`──────┼─────────────┼─────────────┼─────────────┼─────────────┼────────────┤
    XXX           &kp C_PWR     &kp C_SLEEP   XXX           XXX           XXX           &sys_reset                                   &sys_reset    XXX           XXX           XXX           XXX           XXX           XXX
//├─────────────┼─────────────┼─────────────┼─────────────┼─────────────┼─────────────┼─────────────┼─────────────┤  ├─────────────┼─────────────┼─────────────┼─────────────┼─────────────┼─────────────┼─────────────┼─────────────┤
    XXX           &kp K_PWR     &kp K_SLEEP   XXX           XXX           XXX           &bootloader                                  &bootloader   XXX           &kp RSHFT     &kp RCTRL     &kp RALT      &kp RGUI      XXX
//├─────────────┼─────────────┼─────────────┼─────────────┼─────────────┼─────────────┼─────────────┼─────────────┤  ├─────────────┼─────────────┼─────────────┼─────────────┼─────────────┼─────────────┼─────────────┼─────────────┤
    &bt BT_CLR_ALL &bt_0         &bt_1         &bt_2        &bt_3         XXX           XXX            XXX             XXX           XXX           XXX             XXX           XXX           XXX         XXX           XXX
//├─────────────┼─────────────┼─────────────┼─────────────┼─────────────┼─────────────┼─────────────┼─────────────┤  ├─────────────┼─────────────┼─────────────┼─────────────┼─────────────┼─────────────┼─────────────┼─────────────┤
    XXX           XXX           XXX           XXX                         XXX           XXX           XXX              XXX           XXX           &tog SYS                    XXX           XXX           XXX           XXX
//╰─────────────┴─────────────┴─────────────┴─────────────┴─────────────┴─────────────┴─────────────┴─────────────╯  ╰─────────────┴─────────────┴─────────────┴─────────────┴─────────────┴─────────────┴─────────────┴─────────────╯
,&inc_dec_kp LEFT RIGHT)
